#include <Encoder.h>

#include "MIDIUSB.h"
#include <JC_Button.h>
#include <U8g2lib.h>
#include <U8x8lib.h>
#include <Wire.h>

// Define Input pins

#define pinButton1 10
#define pinButton2 9
#define pinButton3 14
#define pinButton4 15
#define pinSwitch1 18
#define pinRotaryButton1 4
#define pinRotaryButton2 8
#define encoder1PinA 5
#define encoder1PinB 16
#define encoder2PinA 6
#define encoder2PinB 7

const unsigned char brainlet[] PROGMEM = {
    0xFF, 0xFF, 0xFF, 0xFF, 0xFF, 0xFF, 0xFF, 0xFF, 0xFF, 0xFF, 0xFF, 0xFF,
    0xFF, 0xFF, 0xFF, 0xFF, 0xFF, 0xFF, 0xFF, 0xFF, 0xFF, 0xFF, 0xFF, 0xFF,
    0xFF, 0xFF, 0xFF, 0xFF, 0xFF, 0xFF, 0xFF, 0xFF, 0xFF, 0xFF, 0xFF, 0xFF,
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    0xFF, 0xFF, 0xFF, 0xFF,
};

// Intantiate Objects
U8G2_SSD1306_128X64_NONAME_F_HW_I2C u8g2(U8G2_R0, /* reset=*/U8X8_PIN_NONE);

bool pullup = true;
bool invert = true;
Button Button1(pinButton1, 38, pullup, invert);
Button Button2(pinButton2, 38, pullup, invert);
Button Button3(pinButton3, 38, pullup, invert);
Button Button4(pinButton4, 38, pullup, invert);
Button Switch1(pinSwitch1, 38, pullup, invert);
Button RotaryButton1(pinRotaryButton1, 38, pullup, invert);
Button RotaryButton2(pinRotaryButton2, 38, pullup, invert);

int buttonConfig = 0;
int rotaryConfig = 0;
int switchState = 0;

// Rotary Globs
int counter[] = {64, 64, 64, 64, 64, 64};
int counterDelta[] = {64, 64, 64, 64, 64, 64};
int aState1;
int bState1;
int aLastState1;
int aState2;
int bState2;
int aLastState2;
int accCoef = 3;

void noteOn(byte channel, byte pitch, byte velocity) {
  midiEventPacket_t noteOn = {0x09, 0x90 | channel, pitch, velocity};
  MidiUSB.sendMIDI(noteOn);
}

void noteOff(byte channel, byte pitch, byte velocity) {
  midiEventPacket_t noteOff = {0x08, 0x80 | channel, pitch, velocity};
  MidiUSB.sendMIDI(noteOff);
}

void controlChange(int controlch, byte channel, byte control, byte value) {
  if (counter[controlch] != counterDelta[controlch]) {

    midiEventPacket_t event = {0x0B, 0xB0 | channel, control, value};

    MidiUSB.sendMIDI(event);
  }
  MidiUSB.flush();
}

void sendMIDI() { MidiUSB.flush(); }

void BInfNoteOn(int note) {
  switch (buttonConfig) {
  case 0:
    switchState = 0;
    break;

  case 1:
    switchState = 4;
    break;

  case 2:
    switchState = 8;
    break;

  case 3:
    switchState = 12;
    break;

  default:
    switchState = 0;
    break;
  }
  if (Switch1.isPressed()) {
    switchState += 47;
  }
  noteOn(0, note + switchState, 127);
  MidiUSB.flush();
}

void BInfNoteOff(int note) {
  switch (buttonConfig) {
  case 0:
    switchState = 0;
    break;

  case 1:
    switchState = 4;
    break;

  case 2:
    switchState = 8;
    break;

  case 3:
    switchState = 12;
    break;

  default:
    break;
  }
  if (Switch1.isPressed()) {
    switchState += 47;
  }
  noteOff(0, note + switchState, 127);
  MidiUSB.flush();
}

void displayOLEDInit() {
  u8g2.clearBuffer();
  u8g2.drawXBMP(0, 0, 128, 128, brainlet);
  u8g2.sendBuffer();
  delay(2000);
  u8g2.clearBuffer();
  u8g2.sendBuffer();
}

void displayOLEDLoop() {
  u8g2.clearBuffer();
  u8g2.setFont(u8g2_font_HelvetiPixel_tr);
  u8g2.setCursor(3, 13);
  u8g2.print("B_Pos[]: ");
  u8g2.setCursor(60, 13);
  u8g2.print(buttonConfig);
  u8g2.setCursor(3, 27);
  u8g2.print("R_Pos[]: ");
  u8g2.setCursor(60, 27);
  u8g2.print(rotaryConfig);
  u8g2.setCursor(3, 41);
  u8g2.print("R_Acc: ");
  u8g2.setCursor(60, 41);
  u8g2.print(accCoef);
  u8g2.sendBuffer();
}

void setup(void) {
  u8g2.begin();
  pinMode(encoder1PinA, INPUT);
  pinMode(encoder1PinB, INPUT);
  RotaryButton1.begin();
  RotaryButton2.begin();
  Button1.begin();
  Button2.begin();
  Button3.begin();
  Button4.begin();
  Switch1.begin();
//  Serial.begin(9600);
  displayOLEDInit();
  displayOLEDLoop();
  aLastState1 = digitalRead(encoder1PinA);
  aLastState2 = digitalRead(encoder1PinB);
}

void loop() {

  aState1 = digitalRead(encoder1PinA);
  bState1 = digitalRead(encoder1PinB);
  if (aState1 != aLastState1) {
    if (bState1 != aState1) {
      counter[(2 * rotaryConfig)] -= accCoef;
      if (counter[(2 * rotaryConfig)] < 0) {
        counter[(2 * rotaryConfig)] = 0;
      }
    } else {
      counter[(2 * rotaryConfig)] += accCoef;
      if (counter[(2 * rotaryConfig)] > 127) {
        counter[(2 * rotaryConfig)] = 127;
      }
    }
  }
  aLastState1 = aState1;
  aState2 = digitalRead(encoder2PinA);
  bState2 = digitalRead(encoder2PinB);
  if (aState2 != aLastState2) {
    if (bState2 != aState2) {
      counter[(2 * rotaryConfig) + 1] += accCoef;
      if (counter[(2 * rotaryConfig) + 1] > 127) {
        counter[(2 * rotaryConfig) + 1] = 127;
      }
    } else {
      counter[(2 * rotaryConfig) + 1] -= accCoef;
      if (counter[(2 * rotaryConfig) + 1] < 0) {
        counter[(2 * rotaryConfig) + 1] = 0;
      }
    }
  }
  aLastState2 = aState2;

  // if (counter[(2 * rotaryConfig)] != counterDelta[(2 * rotaryConfig)] ) {
  controlChange((2 * rotaryConfig), 0, (2 * rotaryConfig) + 21,
                counter[(2 * rotaryConfig)]);
  // }
  // if (counter[(2 * rotaryConfig) + 1] != counterDelta[(2 * rotaryConfig) + 1]
  // ) {
  controlChange((2 * rotaryConfig) + 1, 0, (2 * rotaryConfig) + 22,
                counter[(2 * rotaryConfig) + 1]);
  // }
  counterDelta[(2 * rotaryConfig)] = counter[(2 * rotaryConfig)];
  counterDelta[(2 * rotaryConfig) + 1] = counter[(2 * rotaryConfig) + 1];

//  Serial.print(counter[0]);
//  Serial.print(", ");
//  Serial.print(counter[1]);
//  Serial.println(" ");
  Button1.read();
  Button2.read();
  Button3.read();
  Button4.read();
  RotaryButton1.read();
  RotaryButton2.read();
  Switch1.read();

  if (Button1.wasPressed()) {

    if (RotaryButton1.isPressed()) {
      buttonConfig--;
      if (buttonConfig < 0) {
        buttonConfig = 2;
      }
      displayOLEDLoop();
    } else if (RotaryButton2.isPressed()) {
      rotaryConfig--;
      if (rotaryConfig < 0) {
        rotaryConfig = 2;
      }
      displayOLEDLoop();
    } else {
      BInfNoteOn(1);
    }
  }

  if (Button1.wasReleased()) {
    BInfNoteOff(1);
  }
  if (Button2.wasPressed()) {
    if (RotaryButton1.isPressed()) {
      buttonConfig++;
      if (buttonConfig > 2) {
        buttonConfig = 0;
      }
      displayOLEDLoop();
    }

    else if (RotaryButton2.isPressed()) {
      rotaryConfig++;
      if (rotaryConfig > 2) {
        rotaryConfig = 0;
      }
      displayOLEDLoop();
    }

    else {
      BInfNoteOn(2);
    }
  }

  if (Button2.wasReleased()) {
    BInfNoteOff(2);
  }

  if (Button3.wasPressed()) {
    if (RotaryButton2.isPressed()) {
      accCoef--;
      if (accCoef < 1) {
        accCoef = 1;
      }
      displayOLEDLoop();
    }

    else {
      BInfNoteOn(3);
    }
  }

  if (Button3.wasReleased()) {

    BInfNoteOff(3);
  }
  if (Button4.wasPressed()) {

    if (RotaryButton2.isPressed()) {
      accCoef++;
      displayOLEDLoop();
    } else {
      BInfNoteOn(4);
    }
  }

  if (Button4.wasReleased()) {
    BInfNoteOff(4);
  }

  //  sendMIDI();
}